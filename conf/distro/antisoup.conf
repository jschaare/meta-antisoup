## conf/distro/antisoup.conf
```bitbake
require conf/distro/poky.conf
require conf/distro/include/antisoup-features.conf

DISTRO = "antisoup"
DISTRO_NAME = "Antisoup OS"
DISTRO_VERSION_BASE = "0.1"
DISTRO_VERSION = "${DISTRO_VERSION_BASE}+snapshot-${DATE}"

SDK_VENDOR = "-assdk"
SDK_VERSION := "${@'${DISTRO_VERSION}'.replace('snapshot-${DATE}','snapshot')}"

MAINTAINER = "Justin Schaare <>"

TARGET_VENDOR = "-antisoup"

SANITY_TESTED_DISTROS ?= " \
            ubuntu-18.04 \n \
            ubuntu-20.04 \n \
            "

GCCVERSION_aarch64 = "8.%"
SDKGCCVERSION = "9.%"

DISTRO_FEATURES_append += " virtualization systemd "
INIT_MANAGER = "systemd"
```

## conf/layer.conf
```bitbake
BBPATH .= ":${LAYERDIR}"
BBFILES += "${LAYERDIR}/recipes-*/*/*.bb"
BBFILES += "${LAYERDIR}/recipes-*/*/*.bbappend"

BBFILE_COLLECTIONS += "antisoup"
BBFILE_PATTERN_antisoup = "^${LAYERDIR}/"
BBFILE_PRIORITY_antisoup = "5"

LAYERSERIES_COMPAT_antisoup = "dunfell"

BB_DANGLINGAPPENDS_WARNONLY ?= "1"
```
